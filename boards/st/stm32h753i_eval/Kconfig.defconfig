## boards/st/stm32h753i_eval/Kconfig.defconfig
```kconfig
# STM32H753I-EVAL board configuration

if BOARD_STM32H753I_EVAL

if NETWORKING

config NET_L2_ETHERNET
	default y

endif # NETWORKING

endif # BOARD_STM32H753I_EVAL
```

## boards/st/stm32h753i_eval/board.yml
```yaml
board:
  name: stm32h753i_eval
  full_name: STM32H753I-EVAL
  vendor: st
  socs:
  - name: stm32h753xx
```

## zephyr/Kconfig
```kconfig
config FPRIME_STM32H7_RAMECC
    bool "Enable STM32H7 RAM ECC protection"
    depends on SOC_SERIES_STM32H7X
    select USE_STM32_HAL_RAMECC
    select USE_STM32_HAL_MDMA
    select REBOOT
    help
      Enable SRAM ECC monitoring, fault handling, and background
      memory scrubbing for the STM32H7 application.
```
